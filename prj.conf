## CMakeLists.txt
```
# SPDX-License-Identifier: Apache-2.0

cmake_minimum_required(VERSION 3.20.0)

find_package(Zephyr REQUIRED HINTS $ENV{ZEPHYR_BASE})
project(test2)

FILE(GLOB app_sources src/*.c)
target_sources(app PRIVATE
  ${app_sources}
  )

zephyr_library_include_directories(${ZEPHYR_BASE}/samples/bluetooth)
```

## prj.conf
```kconfig
CONFIG_BT=y
CONFIG_LOG=y
CONFIG_BT_SMP=y
CONFIG_BT_PERIPHERAL=y
CONFIG_BT_DIS=y
CONFIG_BT_DIS_PNP=n
CONFIG_BT_BAS=y
CONFIG_BT_HRS=y
CONFIG_BT_DEVICE_NAME="Zephyr Heartrate Sensor"
CONFIG_BT_DEVICE_APPEARANCE=833
CONFIG_DEBUG_OPTIMIZATIONS=y
CONFIG_DEBUG_THREAD_INFO=y
```

## src/main.c
```c
/* main.c - Application main entry point */

/*
 * Copyright (c) 2024 Nordic Semiconductor ASA
 * Copyright (c) 2015-2016 Intel Corporation
 *
 * SPDX-License-Identifier: Apache-2.0
 */

#include <zephyr/device.h>
#include <zephyr/devicetree.h>

#include "bluetooth.h"
#include "twi_master.h"
#include "MAX30101.h"


#if defined(CONFIG_GPIO)
/* The devicetree node identifier for the "led0" alias. */
#define LED0_NODE DT_ALIAS(led0)

#if DT_NODE_HAS_STATUS_OKAY(LED0_NODE)
#include <zephyr/drivers/gpio.h>
#define HAS_LED     1
static const struct gpio_dt_spec led = GPIO_DT_SPEC_GET(LED0_NODE, gpios);
#define BLINK_ONOFF K_MSEC(500)

static struct k_work_delayable blink_work;
static bool                  led_is_on;

static void blink_timeout(struct k_work *work)
{
	led_is_on = !led_is_on;
	gpio_pin_set(led.port, led.pin, (int)led_is_on);

	k_work_schedule(&blink_work, BLINK_ONOFF);
}

static int blink_setup(void)
{
	int err;

	printk("Checking LED device...");
	if (!gpio_is_ready_dt(&led)) {
		printk("failed.\n");
		return -EIO;
	}
	printk("done.\n");

	printk("Configuring GPIO pin...");
	err = gpio_pin_configure_dt(&led, GPIO_OUTPUT_ACTIVE);
	if (err) {
		printk("failed.\n");
		return -EIO;
	}
	printk("done.\n");

	k_work_init_delayable(&blink_work, blink_timeout);

	return 0;
}

static void blink_start(void)
{
	printk("Start blinking LED...\n");
	led_is_on = false;
	gpio_pin_set(led.port, led.pin, (int)led_is_on);
	k_work_schedule(&blink_work, BLINK_ONOFF);
}

static void blink_stop(void)
{
	struct k_work_sync work_sync;

	printk("Stop blinking LED.\n");
	k_work_cancel_delayable_sync(&blink_work, &work_sync);

	/* Keep LED on */
	led_is_on = true;
	gpio_pin_set(led.port, led.pin, (int)led_is_on);
}
#endif /* LED0_NODE */
#endif /* CONFIG_GPIO */

int main(void)
{
        int err;

        err = twi_master_init();
        if (err) {
                return 0;
        }

        err = bluetooth_init();
        if (err) {
                return 0;
        }

        (void)max30101_init();

#if defined(HAS_LED)
        err = blink_setup();
        if (err) {
                return 0;
        }

        blink_start();
#endif /* HAS_LED */

        while (1) {
                k_sleep(K_SECONDS(1));

                bluetooth_notify();

                if (bluetooth_was_connected()) {
#if defined(HAS_LED)
                        blink_stop();
#endif /* HAS_LED */
                } else if (bluetooth_was_disconnected()) {
                        bluetooth_restart_adv();
#if defined(HAS_LED)
                        blink_start();
#endif /* HAS_LED */
                }
        }

        return 0;
}
```

## src/MAX30101.c
```c
#include <zephyr/kernel.h>
#include <zephyr/device.h>
#include <zephyr/drivers/i2c.h>
#include "MAX30101.h"


/* Assume sensor is connected to i2c0 */
#define I2C_NODE DT_NODELABEL(i2c0)

static const struct i2c_dt_spec max30101_i2c = I2C_DT_SPEC_GET(I2C_NODE);

int max30101_init(void)
{
    int err;

    if (!device_is_ready(max30101_i2c.bus)) {
        printk("I2C bus not ready\n");
        return -ENODEV;
    }

    err = i2c_reg_write_byte_dt(&max30101_i2c, MAX30101_REG_MODE_CFG, MAX30101_MODE_MULTI_LED);
    if (err) {
        printk("Failed to set mode (err %d)\n", err);
        return err;
    }

    err = i2c_reg_write_byte_dt(&max30101_i2c, MAX30101_REG_LED1_PA, MAX30101_LED_CURRENT_3MA);
    if (err) {
        printk("Failed to set LED1 current (err %d)\n", err);
        return err;
    }

    err = i2c_reg_write_byte_dt(&max30101_i2c, MAX30101_REG_LED2_PA, MAX30101_LED_CURRENT_3MA);
    if (err) {
        printk("Failed to set LED2 current (err %d)\n", err);
        return err;
    }

    err = i2c_reg_write_byte_dt(&max30101_i2c, MAX30101_REG_LED3_PA, MAX30101_LED_CURRENT_3MA);
    if (err) {
        printk("Failed to set LED3 current (err %d)\n", err);
        return err;
    }

    printk("MAX30101 initialized\n");
    return 0;
}

int max30101_write_reg(uint8_t reg, uint8_t value)
{
    return i2c_reg_write_byte_dt(&max30101_i2c, reg, value);
}

int max30101_read_reg(uint8_t reg, uint8_t *value)
{
    return i2c_reg_read_byte_dt(&max30101_i2c, reg, value);
}

int max30101_read_fifo(uint8_t *buf, size_t len)
{
    return i2c_burst_read_dt(&max30101_i2c, MAX30101_REG_FIFO_DATA, buf, len);
}

int max30101_reset_fifo(void)
{
    int err;

    err = max30101_write_reg(MAX30101_REG_FIFO_WR_PTR, 0);
    if (err) {
        return err;
    }
    err = max30101_write_reg(MAX30101_REG_OVF_COUNTER, 0);
    if (err) {
        return err;
    }
    err = max30101_write_reg(MAX30101_REG_FIFO_RD_PTR, 0);
    return err;
}

int max30101_set_led_amplitude(uint8_t red, uint8_t ir, uint8_t green)
{
    int err;

    err = max30101_write_reg(MAX30101_REG_LED1_PA, red);
    if (err) {
        return err;
    }
    err = max30101_write_reg(MAX30101_REG_LED2_PA, ir);
    if (err) {
        return err;
    }
    err = max30101_write_reg(MAX30101_REG_LED3_PA, green);
    return err;
}
```

## src/MAX30101.h
```c
#ifndef MAX30101_H_
#define MAX30101_H_

#include <zephyr/sys/util.h>

/* I2C address */
#define MAX30101_I2C_ADDR         0x57

/* Register addresses */
#define MAX30101_REG_INTR_STATUS_1    0x00
#define MAX30101_REG_INTR_STATUS_2    0x01
#define MAX30101_REG_INTR_ENABLE_1    0x02
#define MAX30101_REG_INTR_ENABLE_2    0x03
#define MAX30101_REG_FIFO_WR_PTR      0x04
#define MAX30101_REG_OVF_COUNTER      0x05
#define MAX30101_REG_FIFO_RD_PTR      0x06
#define MAX30101_REG_FIFO_DATA        0x07
#define MAX30101_REG_FIFO_CFG         0x08
#define MAX30101_REG_MODE_CFG         0x09
#define MAX30101_REG_SPO2_CFG         0x0A
#define MAX30101_REG_LED1_PA          0x0C
#define MAX30101_REG_LED2_PA          0x0D
#define MAX30101_REG_LED3_PA          0x0E
#define MAX30101_REG_MULTI_LED_CTRL1  0x11
#define MAX30101_REG_MULTI_LED_CTRL2  0x12

/* Useful values */
#define MAX30101_MODE_MULTI_LED   0x07
#define MAX30101_LED_CURRENT_3MA  0x0F

int max30101_init(void);
int max30101_write_reg(uint8_t reg, uint8_t value);
int max30101_read_reg(uint8_t reg, uint8_t *value);
int max30101_read_fifo(uint8_t *buf, size_t len);
int max30101_reset_fifo(void);
int max30101_set_led_amplitude(uint8_t red, uint8_t ir, uint8_t green);

#endif /* MAX30101_H_ */
```

## src/bluetooth.c
```c
#include <zephyr/kernel.h>
#include <zephyr/bluetooth/bluetooth.h>
#include <zephyr/bluetooth/hci.h>
#include <zephyr/bluetooth/conn.h>
#include <zephyr/bluetooth/uuid.h>
#include <zephyr/bluetooth/gatt.h>
#include <zephyr/bluetooth/services/bas.h>
#include <zephyr/bluetooth/services/hrs.h>
#include "bluetooth.h"

/* Notification state */
static bool hrf_ntf_enabled;

static const struct bt_data ad[] = {
    BT_DATA_BYTES(BT_DATA_FLAGS, (BT_LE_AD_GENERAL | BT_LE_AD_NO_BREDR)),
    BT_DATA_BYTES(BT_DATA_UUID16_ALL,
                  BT_UUID_16_ENCODE(BT_UUID_HRS_VAL),
                  BT_UUID_16_ENCODE(BT_UUID_BAS_VAL),
                  BT_UUID_16_ENCODE(BT_UUID_DIS_VAL)),
#if defined(CONFIG_BT_EXT_ADV)
    BT_DATA(BT_DATA_NAME_COMPLETE, CONFIG_BT_DEVICE_NAME,
            sizeof(CONFIG_BT_DEVICE_NAME) - 1),
#endif /* CONFIG_BT_EXT_ADV */
};

#if !defined(CONFIG_BT_EXT_ADV)
static const struct bt_data sd[] = {
    BT_DATA(BT_DATA_NAME_COMPLETE, CONFIG_BT_DEVICE_NAME,
            sizeof(CONFIG_BT_DEVICE_NAME) - 1),
};
#endif /* !CONFIG_BT_EXT_ADV */

/* Use atomic variable, 2 bits for connection and disconnection state */
static ATOMIC_DEFINE(state, 2U);

#define STATE_CONNECTED    0U
#define STATE_DISCONNECTED 1U

static void connected(struct bt_conn *conn, uint8_t err)
{
    if (err) {
        printk("Connection failed, err 0x%02x %s\n", err, bt_hci_err_to_str(err));
    } else {
        printk("Connected\n");
        (void)atomic_set_bit(state, STATE_CONNECTED);
    }
}

static void disconnected(struct bt_conn *conn, uint8_t reason)
{
    printk("Disconnected, reason 0x%02x %s\n", reason, bt_hci_err_to_str(reason));
    (void)atomic_set_bit(state, STATE_DISCONNECTED);
}

BT_CONN_CB_DEFINE(conn_callbacks) = {
    .connected = connected,
    .disconnected = disconnected,
};

static void hrs_ntf_changed(bool enabled)
{
    hrf_ntf_enabled = enabled;

    printk("HRS notification status changed: %s\n",
           enabled ? "enabled" : "disabled");
}

static struct bt_hrs_cb hrs_cb = {
    .ntf_changed = hrs_ntf_changed,
};

static void auth_cancel(struct bt_conn *conn)
{
    char addr[BT_ADDR_LE_STR_LEN];

    bt_addr_le_to_str(bt_conn_get_dst(conn), addr, sizeof(addr));

    printk("Pairing cancelled: %s\n", addr);
}

static struct bt_conn_auth_cb auth_cb_display = {
    .cancel = auth_cancel,
};

static void bas_notify(void)
{
    uint8_t battery_level = bt_bas_get_battery_level();

    battery_level--;

    if (!battery_level) {
        battery_level = 100U;
    }

    bt_bas_set_battery_level(battery_level);
}

static void hrs_notify(void)
{
    static uint8_t heartrate = 90U;

    /* Heartrate measurements simulation */
    heartrate++;
    if (heartrate == 160U) {
        heartrate = 90U;
    }

    if (hrf_ntf_enabled) {
        bt_hrs_notify(heartrate);
    }
}

#if defined(CONFIG_BT_EXT_ADV)
static struct bt_le_ext_adv *adv;
#endif

int bluetooth_init(void)
{
    int err;

    err = bt_enable(NULL);
    if (err) {
        printk("Bluetooth init failed (err %d)\n", err);
        return err;
    }

    printk("Bluetooth initialized\n");

    bt_conn_auth_cb_register(&auth_cb_display);
    bt_hrs_cb_register(&hrs_cb);

#if !defined(CONFIG_BT_EXT_ADV)
    printk("Starting Legacy Advertising (connectable and scannable)\n");
    err = bt_le_adv_start(BT_LE_ADV_CONN, ad, ARRAY_SIZE(ad), sd, ARRAY_SIZE(sd));
    if (err) {
        printk("Advertising failed to start (err %d)\n", err);
        return err;
    }
#else /* CONFIG_BT_EXT_ADV */
    struct bt_le_adv_param adv_param = {
        .id = BT_ID_DEFAULT,
        .sid = 0U,
        .secondary_max_skip = 0U,
        .options = (BT_LE_ADV_OPT_EXT_ADV |
                    BT_LE_ADV_OPT_CONNECTABLE |
                    BT_LE_ADV_OPT_CODED),
        .interval_min = BT_GAP_ADV_FAST_INT_MIN_2,
        .interval_max = BT_GAP_ADV_FAST_INT_MAX_2,
        .peer = NULL,
    };

    printk("Creating a Coded PHY connectable non-scannable advertising set\n");
    err = bt_le_ext_adv_create(&adv_param, NULL, &adv);
    if (err) {
        printk("Failed to create Coded PHY extended advertising set (err %d)\n", err);

        printk("Creating a non-Coded PHY connectable non-scannable advertising set\n");
        adv_param.options &= ~BT_LE_ADV_OPT_CODED;
        err = bt_le_ext_adv_create(&adv_param, NULL, &adv);
        if (err) {
            printk("Failed to create extended advertising set (err %d)\n", err);
            return err;
        }
    }

    printk("Setting extended advertising data\n");
    err = bt_le_ext_adv_set_data(adv, ad, ARRAY_SIZE(ad), NULL, 0);
    if (err) {
        printk("Failed to set extended advertising data (err %d)\n", err);
        return err;
    }

    printk("Starting Extended Advertising (connectable non-scannable)\n");
    err = bt_le_ext_adv_start(adv, BT_LE_EXT_ADV_START_DEFAULT);
    if (err) {
        printk("Failed to start extended advertising set (err %d)\n", err);
        return err;
    }
#endif /* CONFIG_BT_EXT_ADV */

    printk("Advertising successfully started\n");

    return 0;
}

int bluetooth_restart_adv(void)
{
    int err;

#if !defined(CONFIG_BT_EXT_ADV)
    printk("Starting Legacy Advertising (connectable and scannable)\n");
    err = bt_le_adv_start(BT_LE_ADV_CONN, ad, ARRAY_SIZE(ad), sd, ARRAY_SIZE(sd));
    if (err) {
        printk("Advertising failed to start (err %d)\n", err);
    }
#else /* CONFIG_BT_EXT_ADV */
    printk("Starting Extended Advertising (connectable and non-scannable)\n");
    err = bt_le_ext_adv_start(adv, BT_LE_EXT_ADV_START_DEFAULT);
    if (err) {
        printk("Failed to start extended advertising set (err %d)\n", err);
    }
#endif /* CONFIG_BT_EXT_ADV */

    return err;
}

void bluetooth_notify(void)
{
    hrs_notify();
    bas_notify();
}

bool bluetooth_was_connected(void)
{
    return atomic_test_and_clear_bit(state, STATE_CONNECTED);
}

bool bluetooth_was_disconnected(void)
{
    return atomic_test_and_clear_bit(state, STATE_DISCONNECTED);
}
```

## src/bluetooth.h
```c
#ifndef BLUETOOTH_H_
#define BLUETOOTH_H_

int bluetooth_init(void);
void bluetooth_notify(void);
bool bluetooth_was_connected(void);
bool bluetooth_was_disconnected(void);
int bluetooth_restart_adv(void);

#endif /* BLUETOOTH_H_ */
```

## src/twi_master.c
```c
#include <zephyr/kernel.h>
#include <zephyr/device.h>
#include <zephyr/drivers/i2c.h>

#define TWI_NODE DT_NODELABEL(i2c0)

static const struct device *const twi_dev = DEVICE_DT_GET(TWI_NODE);

int twi_master_init(void)
{
    if (!device_is_ready(twi_dev)) {
        printk("TWI master device not ready\n");
        return -ENODEV;
    }

    return 0;
}

const struct device *twi_master_device_get(void)
{
    return twi_dev;
}
```

## src/twi_master.h
```c
#ifndef TWI_MASTER_H_
#define TWI_MASTER_H_

#include <zephyr/device.h>

int twi_master_init(void);
const struct device *twi_master_device_get(void);

#endif /* TWI_MASTER_H_ */
```
